## Kconfig
```kconfig
# AOSC OS Image Builder Config menu

mainmenu "AOSC OS Image Builder"

comment "General Platform configuration"

# Predefined config variables
source "include/Kconfig/predefined.Kconfig"

# Architecture configuration
source "arch/Kconfig"

# source "platform/Kconfig"
# source "device/Kconfig"

comment "Image Configuration"

source "image/Kconfig"
#

comment "Distro Configuration"

source "distro/Kconfig"
```

## arch/Kconfig
```kconfig
choice
prompt "Architecture Selection"

comment "Target Architecture"

config ARCH_AMD64
	bool "x86-64 Architecture"
	help
		Create image for x86-64 architecture.

config ARCH_ARM64
	bool "ARM Aarch64 Architecture"
	help
		Create image for ARM64 architecture.

config ARCH_RISCV64
	bool "RISC-V Architecture"
	help
		Create image for RISC-V architecture.

config ARCH_LOONGARCH64
	bool "Loongson LoongArch Architecture"
	help
		Create image for LoongArch architecture.

endchoice

config ARCH
	string
	default "arm64" if ARCH_ARM64
	default "amd64" if ARCH_AMD64
	default "riscv64" if ARCH_RISCV64
	default "loongarch64" if ARCH_LOONGARCH64

source "arch/amd64/platform/Kconfig"

source "arch/arm64/platform/Kconfig"
```

## arch/amd64/platform/Kconfig
```kconfig
# Platform selection for AMD64

if ARCH_AMD64

choice
prompt "Platform Selection for AMD64"

config AMD64_GENERIC

	bool "Generic x86-64"
	select SUPPORTS_VMDK
	select SUPPORTS_RAWIMG
	select SUPPORTS_NVIDIA
	select HAS_LIVEKIT
	select VARIANT_BASE
	select VARIANT_DESKTOP
	select VARIANT_SERVER

endchoice

endif # ARCH_AMD64

source "device/amd64-generic/Kconfig"
```

## arch/arm64/platform/Kconfig
```kconfig
if ARCH_ARM64

choice
prompt "Platform Selection for ARM64"

config ARM64_SUNXI64
	bool "Devices with AllWinner SoC"

config ARM64_RK64
	bool "Devices with Rockchip SoC"

config ARM64_RPI64
	bool "Raspberry Pis with BCM2835 based SoC"

endchoice

endif
```

## device/amd64-generic/Kconfig
```kconfig
if ARCH_AMD64

if AMD64_GENERIC

choice 
	prompt "Device selection"

config AMD64_GENERIC_GENERIC
	bool "Generic x86_64 PC"
	default y if AMD64_GENERIC

endchoice

endif # AMD64_GENERIC

endif # ARCH_AMD64
```

## distro/Kconfig
```kconfig
comment "User Configuration"

config CREATE_USER
	bool "Create a default user"
	default y

if CREATE_USER

config USERNAME
	string "Default user name"
	default aosc

config PASSWORD
	string "Password of the default user"
	default anthon

config USER_HAS_SSH_KEY
	bool "Add SSH Key for the default user"
	default n

config USER_SSH_KEY
	string "SSH Key for the default user" if USER_HAS_SSH_KEY

endif # CREATE_USER

if CREATE_USER != y

config ROOT_HAS_PASSWORD
	bool "Set password for root user"

if ROOT_HAS_PASSWORD

config ROOT_PASSWORD
	string "Password of root user"

endif # ROOT_HAS_PASSWORD

if ROOT_HAS_PASSWORD != y

config ROOT_SSHKEY
	string "Authorized SSH Key for root user"

endif # ROOT_HAS_PASSWORD != y

endif # CREATE_USER != y

comment "Miscellaneous Configuration"

config HOSTNAME
	string "Default hostname"
	default "$(HOSTNAME)"

config TIMEZONE
	string "Default time zone"
	default "Asia/Shanghai"
```

## image/Kconfig
```kconfig
# Image options

config IMGSIZE_SMALL
	bool
	default n

config IMGSIZE_LARGE
	bool
	default n

choice IMAGE
prompt "Image to generate"

config IMAGE_VMDK
	bool "Virtual Disk Image (vmdk)" if SUPPORTS_VMDK

config IMAGE_RAW
	bool "Flashable Raw Image" if SUPPORTS_RAWIMG

endchoice

config IMAGE_LIVEKIT
	bool "Generate LiveKit ISO Image" if HAS_LIVEKIT
	default n

choice IMAGE_VARIANT
prompt "OS Variant of the image"

config IMAGE_BASE
	bool "Base (Minimal set of packages for headless use)"
	select IMGSIZE_SMALL

config IMAGE_DESKTOP
	bool "Desktop (Preinstalled with DE, applications, etc., "
	select IMGSIZE_LARGE

config IMAGE_SERVER
	bool "Server (Preinstalled with various server packages w/o Desktop)"
	select IMGSIZE_SMALL

endchoice

config WITH_NVIDIA
	bool "Install proprietary Nvidia driver" if SUPPORTS_NVIDIA && IMAGE_DESKTOP
	default n

source "image/vmdk/Kconfig"

source "image/raw/Kconfig"

config CUSTOM_PACKAGES
	bool "Preinstall packages while generating image"
	default n

if CUSTOM_PACKAGES

comment "Warning, be careful to disk usage of the generated image"

config PREINST_PACKAGE_LIST
	string "List of packages seperated with commas" if CUSTOM_PACKAGES

endif
```

## image/raw/Kconfig
```kconfig
if IMAGE_RAW

config RAWIMG_SIZE
	int "Raw Image Size"
	default 6144 if IMGSIZE_SMALL
	default 12800 if IMGSIZE_LARGE
	range 6144 32768

comment "Image partition table depends on which device is selected"

endif
```

## image/vmdk/Kconfig
```kconfig
if IMAGE_VMDK

config VMDK_SIZE
	int "Virtual Disk Size (MiB)"
	default 65536 if IMGSIZE_SMALL
	default 65536 if IMGSIZE_LARGE
	range 16384 4294967296

choice
prompt "Partition Map"

config VMDK_MBR
	bool "Master Boot Record (MBR)"

config VMDK_GPT
	bool "GUID Partition Table (GPT)"

endchoice

endif
```
